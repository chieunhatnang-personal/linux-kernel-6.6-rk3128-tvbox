## drivers/net/wireless/rockchip_wlan/rkwifi/rtl8189es/Kconfig
```kconfig
# SPDX-License-Identifier: GPL-2.0
config RTL8189ES
	tristate "Realtek 8189E SDIO WiFi"
	depends on MMC
	help
	  Enable the Realtek RTL8189ES SDIO WLAN driver.
```

## drivers/net/wireless/rockchip_wlan/rkwifi/rtl8189fs/Kconfig
```kconfig
# SPDX-License-Identifier: GPL-2.0
config RTL8189FS
	tristate "Realtek 8189F SDIO WiFi"
	depends on MMC
	help
	  Enable the Realtek RTL8189FS SDIO WLAN driver.
```

## drivers/net/wireless/rockchip_wlan/rkwifi/ssv6xxx/Kconfig
```kconfig
# SPDX-License-Identifier: GPL-2.0
menu "SouthSV 6XXX WLAN support"
config SSV6051
	tristate "ssv6XXX Wireless driver"
	depends on MAC80211 && MMC
	help
	  Enable the South Silicon Valley SSV6051 SDIO WLAN driver.

endmenu
```
